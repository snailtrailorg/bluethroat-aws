DECLARE_CONFIG_SOUND_INTEGER(CONFIG_SOUND_LIFT_FREQUENCY_MINIMUM, "lift_freq_min", NVS_TYPE_I32, 600),
DECLARE_CONFIG_SOUND_INTEGER(CONFIG_SOUND_LIFT_FREQUENCY_MAXIMUM, "lift_freq_max", NVS_TYPE_I32, 1800),
DECLARE_CONFIG_SOUND_INTEGER(CONFIG_SOUND_LIFT_FREQUENCY_FACTOR, "lift_freq_fctr", NVS_TYPE_I32, 400),
DECLARE_CONFIG_SOUND_INTEGER(CONFIG_SOUND_LIFT_CYCLE_MINIMUM, "lift_cycle_min", NVS_TYPE_I32, 125),
DECLARE_CONFIG_SOUND_INTEGER(CONFIG_SOUND_LIFT_CYCLE_MAXIMUM, "lift_cycle_max", NVS_TYPE_I32, 500),
DECLARE_CONFIG_SOUND_INTEGER(CONFIG_SOUND_LIFT_CYCLE_FACTOR, "lift_cycle_fctr", NVS_TYPE_I32, 300),
DECLARE_CONFIG_SOUND_INTEGER(CONFIG_SOUND_LIFT_DUTY_MINMUM, "lift_duty_min", NVS_TYPE_I32, 80),
DECLARE_CONFIG_SOUND_INTEGER(CONFIG_SOUND_LIFT_DUTY_MAXMUM, "lift_duty_max", NVS_TYPE_I32, 200),
DECLARE_CONFIG_SOUND_INTEGER(CONFIG_SOUND_LIFT_DUTY_FACTOR, "lift_duty_fctr", NVS_TYPE_I32, 500),
DECLARE_CONFIG_SOUND_INTEGER(CONFIG_SOUND_SINK_FREQUENCY_MINIMUM, "sink_freq_min", NVS_TYPE_I32, 300),
DECLARE_CONFIG_SOUND_INTEGER(CONFIG_SOUND_SINK_FREQUENCY_MAXIMUM, "sink_freq_max", NVS_TYPE_I32, 800),
DECLARE_CONFIG_SOUND_INTEGER(CONFIG_SOUND_SINK_FREQUENCY_FACTOR, "sink_freq_fctr", NVS_TYPE_I32, 400),
DECLARE_CONFIG_SOUND_INTEGER(CONFIG_SOUND_SINK_DUAL_TONE_FACTOR, "dual_tone_fctr", NVS_TYPE_I32, 5),
DECLARE_CONFIG_SOUND_INTEGER(CONFIG_SOUND_SAMPLING_RATE, "sampling_rage", NVS_TYPE_I32, 44100),
DECLARE_CONFIG_SOUND_INTEGER(CONFIG_SOUND_SAMPLING_BITWIDTH, "sampling_width", NVS_TYPE_I32, I2S_BITS_PER_SAMPLE_16BIT),
DECLARE_CONFIG_SOUND_INTEGER(CONFIG_SOUND_THRESHOLD_LIFT_START_SPEED, "lift_start", NVS_TYPE_I32, 20),
DECLARE_CONFIG_SOUND_INTEGER(CONFIG_SOUND_THRESHOLD_LIFT_STOP_SPEED, "lift_stop", NVS_TYPE_I32, 20),
DECLARE_CONFIG_SOUND_INTEGER(CONFIG_SOUND_THRESHOLD_SINK_START_SPEED, "sink_start", NVS_TYPE_I32, -300),
DECLARE_CONFIG_SOUND_INTEGER(CONFIG_SOUND_THRESHOLD_SINK_STOP_SPEED, "sink_stop", NVS_TYPE_I32, -300),
DECLARE_CONFIG_SOUND_INTEGER(CONFIG_SOUND_ANY, NULL, NVS_TYPE_ANY, 0),